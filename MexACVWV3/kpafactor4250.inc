KPAFACTOR4250: ;* Interpolated from 0.098V = 20KPA, 1.761V = 101.4KPA Bench test RJH 9/15/23
        DB      100T     ; x=000;=0.000v;sensor failure
        DB      16T      ; x=001;=0.020v
        DB      17T      ; x=002;=0.039v
        DB      18T      ; x=003;=0.059v
        DB      19T      ; x=004;=0.078v
        DB      20T      ; x=005;=0.098v
        DB      21T      ; x=006;=0.118v
        DB      22T      ; x=007;=0.137v
        DB      23T      ; x=008;=0.157v
        DB      24T      ; x=009;=0.176v
        DB      25T      ; x=010;=0.196v
        DB      26T      ; x=011;=0.216v
        DB      27T      ; x=012;=0.235v
        DB      28T      ; x=013;=0.255v
        DB      29T      ; x=014;=0.275v
        DB      30T      ; x=015;=0.294v
        DB      31T      ; x=016;=0.314v
        DB      32T      ; x=017;=0.333v
        DB      32T      ; x=018;=0.353v
        DB      33T      ; x=019;=0.373v
        DB      34T      ; x=020;=0.392v
        DB      35T      ; x=021;=0.412v
        DB      36T      ; x=022;=0.431v
        DB      37T      ; x=023;=0.451v
        DB      38T      ; x=024;=0.471v
        DB      39T      ; x=025;=0.490v
        DB      40T      ; x=026;=0.510v
        DB      41T      ; x=027;=0.529v
        DB      42T      ; x=028;=0.549v
        DB      43T      ; x=029;=0.569v
        DB      44T      ; x=030;=0.588v
        DB      45T      ; x=031;=0.608v
        DB      46T      ; x=032;=0.627v
        DB      47T      ; x=033;=0.647v
        DB      48T      ; x=034;=0.667v
        DB      49T      ; x=035;=0.686v
        DB      50T      ; x=036;=0.706v
        DB      51T      ; x=037;=0.725v
		DB      52T      ; x=038;=0.745v
		DB      53T      ; x=039;=0.765v
		DB      54T      ; x=040;=0.784v
	    DB      55T      ; x=041;=0.804v
        DB      56T      ; x=042;=0.824v
        DB      56T      ; x=043;=0.843v
        DB      57T      ; x=044;=0.863v
        DB      58T      ; x=045;=0.882v
        DB      59T      ; x=046;=0.902v
        DB      60T      ; x=047;=0.922v
        DB      61T      ; x=048;=0.941v
        DB      62T      ; x=049;=0.961v
        DB      63T      ; x=050;=0.980v
        DB      64T      ; x=051;=1.000v
        DB      65T      ; x=052;=1.020v
        DB      66T      ; x=053;=1.039v
        DB      67T      ; x=054;=1.059v
        DB      68T      ; x=055;=1.078v
        DB      69T      ; x=056;=1.096v
        DB      70T      ; x=057;=1.118v
        DB      71T      ; x=058;=1.137v
        DB      72T      ; x=059;=1.157v
        DB      73T      ; x=060;=1.176v
        DB      74T      ; x=061;=1,196v
        DB      75T      ; x=062;=1,216v
        DB      76T      ; x=063;=1.235v
        DB      77T      ; x=064;=1.255v
        DB      78T      ; x=065;=1.275v
        DB      79T      ; x=066;=1.294v
        DB      80T      ; x=067;=1.314v
        DB      80T      ; x=068;=1.333v
        DB      81T      ; x=069;=1.353v
        DB      82T      ; x=070;=1.373v
        DB      83T      ; x=071;=1.392v
        DB      84T      ; x=072;=1.412v
        DB      85T      ; x=073;=1.431v
        DB      86T      ; x=074;=1.451v
        DB      87T      ; x=075;=1.471v
        DB      88T      ; x=076;=1.490v
        DB      89T      ; x=077;=1.510v
        DB      90T      ; x=078;=1.529v
        DB      91T      ; x=079;=1.549v
        DB      92T      ; x=080;=1.569v
        DB      93T      ; x=081;=1.588v
        DB      94T      ; x=082;=1.608v
        DB      95T      ; x=083;=1.627v
        DB      96T      ; x=084;=1.647v
        DB      97T      ; x=085;=1.667v
        DB      98T      ; x=086;=1.686v
        DB      99T      ; x=087;=1.706v
        DB      100T     ; x=088;=1.725v
        DB      101T     ; x=089;=1.745v
        DB      102T     ; x=090;=1.765v
        DB      103T     ; x=091;=1.784v
        DB      104T     ; x=092;=1.804v
        DB      104T     ; x=093;=1.824v
        DB      105T     ; x=094;=1.843v
        DB      106T     ; x=095;=1.863v
        DB      107T     ; x=096;=1.882v
        DB      108T     ; x=097;=1.902v
        DB      109T     ; x=098;=1.922v
        DB      110T     ; x=099;=1.941v
        DB      111T     ; x=100;=1.961v
        DB      112T     ; x=101;=1.980v
        DB      113T     ; x=102;=2.000v
        DB      114T     ; x=103;=2.020v
        DB      115T     ; x=104;=2.039v
        DB      116T     ; x=105;=2.059v
        DB      117T     ; x=106;=2.078v
        DB      118T     ; x=107;=2.098v
        DB      119T     ; x=108;=2.118v
        DB      120T     ; x=109;=2.137v
        DB      121T     ; x=110;=2.157v
        DB      122T     ; x=111;=2.176v
        DB      123T     ; x=112;=2.196v
        DB      124T     ; x=113;=2.216v
        DB      125T     ; x=114;=2.235v
        DB      126T     ; x=115;=2.255v
        DB      127T     ; x=116;=2.275v
        DB      127T     ; x=117;=2.294v
        DB      128T     ; x=118;=2.314v
        DB      129T     ; x=119;=2.333v
        DB      130T     ; x=120;=2.353v
        DB      131T     ; x=121;=2.373v
        DB      132T     ; x=122;=2.392v
        DB      133T     ; x=123;=2.412v
        DB      134T     ; x=124;=2.431v
        DB      135T     ; x=125;=2.451v
        DB      136T     ; x=126;=2.471v
        DB      137T     ; x=127;=2.490v
        DB      138T     ; x=128;=2.510v
        DB      139T     ; x=129;=2.529v
        DB      140T     ; x=130,=2.549v
        DB      141T     ; x=131;=2.569v
        DB      142T     ; x=132;=2.588v
        DB      143T     ; x=133;=2.608v
        DB      144T     ; x=134;=2.627v
        DB      145T     ; x=135;=2.647v
        DB      146T     ; x=136;=2.667v
        DB      147T     ; x=137;=2.686v
        DB      148T     ; x=138;=2.706v
        DB      149T     ; x=139;=2.725v
        DB      150T     ; x=140;=2.745v
        DB      151T     ; x=141;=2.765v
        DB      151T     ; x=142;=2.784v
        DB      152T     ; x=143;=2.804v
        DB      153T     ; x=144;=0.824v
        DB      154T     ; x=145;=2.843v
        DB      155T     ; x=146;=2.863v
        DB      156T     ; x=147;=2.882v
        DB      157T     ; x=148;=2.902v
        DB      158T     ; x=149;=2.922v
        DB      159T     ; x=150;=2.941v
        DB      160T     ; x=151;=2.961v
        DB      161T     ; x=152;=2.980v
        DB      162T     ; x=153;=3.000v
        DB      163T     ; x=154;=3.020v
        DB      164T     ; x=155;=3.039v
        DB      165T     ; x=156;=3.059v
        DB      166T     ; x=157;=3.078v
        DB      167T     ; x=158;=3.098v
        DB      168T     ; x=159;=3.118v
        DB      169T     ; x=160;=3.137v
        DB      170T     ; x=161;=3.157v
        DB      171T     ; x=162;=3.176v
        DB      172T     ; x=163;=3.196v
        DB      173T     ; x=164;=3.216v
        DB      174T     ; x=165;=3.235v
        DB      175T     ; x=166;=3.255v
        DB      176T     ; x=167;=3.275v
        DB      176T     ; x=168;=3.294v
        DB      177T     ; x=169;=3.314v
        DB      178T     ; x=170;=3.333v
        DB      179T     ; x=171;=3.353v
        DB      180T     ; x=172;=3.373v
        DB      181T     ; x=173;=3.392v
        DB      182T     ; x=174;=3.412v
        DB      183T     ; x=175;=3.431v
        DB      184T     ; x=176;=3.451v
        DB      185T     ; x=177;=3.471v
        DB      186T     ; x=178;=3.490v
        DB      187T     ; x=179;=3.510v
        DB      188T     ; x=180;=3.529v
        DB      189T     ; x=181;=3.549v
        DB      190T     ; x=182;=3.569v
        DB      191T     ; x=183;=3.588v
        DB      192T     ; x=184;=3.608v
        DB      193T     ; x=185;=3.627v
        DB      194T     ; x=186;=3.647v
        DB      195T     ; x=187;=3.667v
        DB      196T     ; x=188;=3.686v
        DB      197T     ; x=189;=3.706v
        DB      198T     ; x=190;=3.725v
        DB      199T     ; x=191;=3.745v
        DB      199T     ; x=192;=3.765v
        DB      200T     ; x=193;=3.784v
        DB      201T     ; x=194;=3.804v
        DB      202T     ; x=195;=3.824v
        DB      203T     ; x=196;=3.843v
        DB      204T     ; x=197;=3.863v
        DB      205T     ; x=198;=3.882v
        DB      206T     ; x=199;=3.902v
        DB      207T     ; x=200;=3.922v
        DB      208T     ; x=201;=3.941v
        DB      209T     ; x=202;=3.961v
        DB      210T     ; x=203;=3.980v
        DB      211T     ; x=204;=4.000v
        DB      212T     ; x=205;=4.020v
        DB      213T     ; x=206;=4.039v
        DB      214T     ; x=207;=4.059v
        DB      215T     ; x=208;=4.078v
        DB      216T     ; x=209;=4.098v
        DB      217T     ; x=210;=4.118v
        DB      218T     ; x=211;=4.137v
        DB      219T     ; x=212;=4.157v
        DB      220T     ; x=213;=4.176v
        DB      221T     ; x=214;=4.196v
        DB      222T     ; x=215;=4.216v
        DB      222T     ; x=216;=4.235v
        DB      223T     ; x=217;=4.255v
        DB      224T     ; x=218;=4.275v
        DB      225T     ; x=219;=4.294v
        DB      226T     ; x=220;=4.314v
        DB      227T     ; x=221;=4.333v
        DB      228T     ; x=222;=4.353v
        DB      229T     ; x=223;=4.373v
        DB      230T     ; x=224;=4.392v
        DB      231T     ; x=225;=4.412v
        DB      232T     ; x=226;=4.431v
        DB      233T     ; x=227;=4.451v
        DB      234T     ; x=228;=4.471v
        DB      235T     ; x=229;=4.490v
        DB      236T     ; x=230;=4.510v
        DB      237T     ; x=231;=4.529v
        DB      238T     ; x=232;=4.549v
        DB      239T     ; x=233;=4.569v
        DB      240T     ; x=234;=4.588v
        DB      241T     ; x=235;=4.608v
        DB      242T     ; x=236;=4.627v
        DB      243T     ; x=237;=4.647v
        DB      244T     ; x=238;=4.667v
        DB      245T     ; x=239;=4.686v
        DB      246T     ; x=240;=4.706v
        DB      246T     ; x=241;=4.725v
        DB      247T     ; x=242;=4.745v
        DB      248T     ; x=243;=4.765v
        DB      249T     ; x=244;=4.784v
        DB      250T     ; x=245;=4.804v
        DB      251T     ; x=246;=4.824v
        DB      252T     ; x=247;=4.843v
        DB      253T     ; x=248;=4.863v
        DB      254T     ; x=249;=4.882v
        DB      255T     ; x=250;=4.902v
        DB      255T     ; x=251;=4.922v
        DB      255T     ; x=252;=4.941v
        DB      255T     ; x=253;=4.961v
        DB      255T     ; x=254;=4.980v
        DB      100T     ; x=255;=5.000v;sensor failure
