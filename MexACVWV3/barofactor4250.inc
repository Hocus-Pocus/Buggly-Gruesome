BAROFAC4250: ;% correction
        DB      100T     ; x=000;=0.000v;=100KPA;=sensor failure
        DB      142T     ; x=001;=0.020v;=16KPA
        DB      142T     ; x=002;=0.039v;=17KPA
        DB      141T     ; x=003;=0.059v;=18KPA
        DB      141T     ; x=004;=0.078v;=19KPA
        DB      140T     ; x=005;=0.098v;=20KPA
        DB      140T     ; x=006;=0.118v;=21KPA
        DB      149T     ; x=007;=0.137v;=22KPA
        DB      139T     ; x=008;=0.157v;=23KPA
        DB      138T     ; x=009;=0.176v;=24KPA
        DB      138T     ; x=010;=0.196v;=25KPA
        DB      137T     ; x=011;=0.216v;=26KPA
        DB      137T     ; x=012;=0.235v;=27KPA
        DB      136T     ; x=013;=0.255v;=28KPA
        DB      136T     ; x=014;=0.275v;=29KPA
        DB      135T     ; x=015;=0.294v;=30KPA
        DB      135T     ; x=016;=0.314v;=31KPA
        DB      134T     ; x=017;=0.333v;=32KPA
        DB      134T     ; x=018;=0.353v;=32KPA
        DB      133T     ; x=019;=0.373v;=33KPA
        DB      133T     ; x=020;=0.392v;=34KPA
        DB      132T     ; x=021;=0.412v;=35KPA
        DB      132T     ; x=022;=0.431v;=36KPA
        DB      131T     ; x=023;=0.451v;=37KPA
        DB      131T     ; x=024;=0.471v;=38KPA
        DB      130T     ; x=025;=0.490v;=39KPA
        DB      130T     ; x=026;=0.510v;=40KPA
        DB      129T     ; x=027;=0.529v;=41KPA
        DB      129T     ; x=028;=0.549v;=42KPA
        DB      128T     ; x=029;=0.569v;=43KPA
        DB      128T     ; x=030;=0.588v;=44KPA
        DB      128T     ; x=031;=0.608v;=45KPA
        DB      127T     ; x=032;=0.627v;=46KPA
        DB      127T     ; x=033;=0.647v;=47KPA
        DB      126T     ; x=034;=0.667v;=48KPA
        DB      126T     ; x=035;=0.686v;=49KPA
        DB      125T     ; x=036;=0.706v;=50KPA
        DB      125T     ; x=037;=0.725v;=51KPA
        DB      124T     ; x=038;=0.745v;=52KPA
        DB      124T     ; x=039;=0.765v;=53KPA
        DB      123T     ; x=040;=0.784v;=54KPA
        DB      123T     ; x=041;=0.804v;=55KPA
        DB      122T     ; x=042;=0.824v;=56KPA
        DB      122T     ; x=043;=0.843v;=56KPA
        DB      121T     ; x=044;=0.863v;=57KPA
        DB      121T     ; x=045;=0.882v;=58KPA
        DB      120T     ; x=046;=0.902v;=59KPA
        DB      120T     ; x=047;=0.922v;=60KPA
        DB      119T     ; x=048;=0.941v;=61KPA
        DB      119T     ; x=049;=0.961v;=62KPA
        DB      118T     ; x=050;=0.980v;=63KPA
        DB      118T     ; x=051;=1.000v;=64KPA
        DB      117T     ; x=052;=1.020v;=65KPA
        DB      117T     ; x=053;=1.039v;=66KPA
        DB      116T     ; x=054;=1.059v;=67KPA
        DB      116T     ; x=055;=1.078v;=68KPA
        DB      116T     ; x=056;=1.096v;=69KPA
        DB      115T     ; x=057;=1.118v;=70KPA
        DB      115T     ; x=058;=1.137v;=71KPA
        DB      114T     ; x=059;=1.157v;=72KPA
        DB      114T     ; x=060;=1.176v;=73KPA
        DB      113T     ; x=061;=1,196v;=74KPA
        DB      113T     ; x=062;=1,216v;=75KPA
        DB      112T     ; x=063;=1.235v;=76KPA
        DB      112T     ; x=064;=1.255v;=77KPA
        DB      111T     ; x=065;=1.275v;=78KPA
        DB      111T     ; x=066;=1.294v;=79KPA
        DB      110T     ; x=067;=1.314v;=80KPA
        DB      110T     ; x=068;=1.333v;=80KPA
        DB      110T     ; x=069;=1.353v;=81KPA
        DB      109T     ; x=070;=1.373v;=82KPA
        DB      109T     ; x=071;=1.392v;=83KPA
        DB      108T     ; x=072;=1.412v;=84KPA
        DB      108T     ; x=073;=1.431v;=85KPA
        DB      107T     ; x=074;=1.451v;=86KPA
        DB      107T     ; x=075;=1.471v;=87KPA
        DB      106T     ; x=076;=1.490v;=88KPA
        DB      106T     ; x=077;=1.510v;=89KPA
        DB      105T     ; x=078;=1.529v;=90KPA
        DB      105T     ; x=079;=1.549v;=91KPA
        DB      104T     ; x=080;=1.569v;=92KPA
        DB      104T     ; x=081;=1.588v;=93KPA
        DB      104T     ; x=082;=1.608v;=94KPA
        DB      103T     ; x=083;=1.627v;=95KPA
        DB      103T     ; x=084;=1.647v;=96KPA
        DB      102T     ; x=085;=1.667v;=97KPA
        DB      102T     ; x=086;=1.686v;=98KPA
        DB      101T     ; x=087;=1.706v;=99KPA
        DB      101T     ; x=088;=1.725v;=100KPA
        DB      100T     ; x=089;=1.745v;=101KPA
        DB      100T     ; x=090;=1.765v;=102KPA
        DB      99T      ; x=091;=1.784v;=103KPA
        DB      99T      ; x=092;=1.804v;=104KPA
        DB      98T      ; x=093;=1.824v;=104KPA
        DB      98T      ; x=094;=1.843v;=105KPA
        DB      98T      ; x=095;=1.863v;=106KPA
        DB      97T      ; x=096;=1.882v;=107KPA
        DB      97T      ; x=097;=1.902v;=108KPA
        DB      96T      ; x=098;=1.922v;=109KPA
        DB      96T      ; x=099;=1.941v;=110KPA
        DB      95T      ; x=100;=1.961v;=111KPA
        DB      95T      ; x=101;=1.980v;=112KPA
        DB      94T      ; x=102;=2.000v;=113KPA
        DB      94T      ; x=103;=2.020v;=114KPA
        DB      93T      ; x=104;=2.039v;=115KPA
        DB      93T      ; x=105;=2.059v;=116KPA
        DB      92T      ; x=106;=2.078v;=117KPA
        DB      92T      ; x=107;=2.098v;=118KPA
        DB      92T      ; x=108;=2.118v;=119KPA
        DB      91T      ; x=109;=2.137v;=120KPA
        DB      91T      ; x=110;=2.157v;=121KPA
        DB      90T      ; x=111;=2.176v;=122KPA
        DB      90T      ; x=112;=2.196v;=123KPA
        DB      89T      ; x=113;=2.216v;=124KPA
        DB      89T      ; x=114;=2.235v;=125KPA
        DB      88T      ; x=115;=2.255v;=126KPA
        DB      88T      ; x=116;=2.275v;=127KPA
        DB      87T      ; x=117;=2.294v;=127KPA
        DB      87T      ; x=118;=2.314v;=128KPA
        DB      87T      ; x=119;=2.333v;=129KPA
        DB      86T      ; x=120;=2.353v;=130KPA
        DB      86T      ; x=121;=2.373v;=131KPA
        DB      85T      ; x=122;=2.392v;=132KPA
        DB      85T      ; x=123;=2.412v;=133KPA
        DB      84T      ; x=124;=2.431v;=134KPA
        DB      84T      ; x=125;=2.451v;=135KPA
        DB      83T      ; x=126;=2.471v;=136KPA
        DB      83T      ; x=127;=2.490v;=137KPA
        DB      82T      ; x=128;=2.510v;=138KPA
        DB      82T      ; x=129;=2.529v;=139KPA
        DB      81T      ; x=130;=2.549v;=140KPA
        DB      81T      ; x=131;=2.569v;=141KPA
        DB      81T      ; x=132;=2.588v;=142KPA
        DB      80T      ; x=133;=2.608v;=143KPA
        DB      80T      ; x=134;=2.627v;=144KPA
        DB      79T      ; x=135;=2.647v;=145KPA
        DB      79T      ; x=136;=2.667v;=146KPA
        DB      78T      ; x=137;=2.686v;=147KPA
        DB      78T      ; x=138;=2.706v;=148KPA
        DB      77T      ; x=139;=2.725v;=149KPA
        DB      77T      ; x=140;=2.745v;=150KPA
        DB      76T      ; x=141;=2.765v;=151KPA
        DB      76T      ; x=142;=2.784v;=151KPA
        DB      75T      ; x=143;=2.804v;=152KPA
        DB      75T      ; x=144;=0.824v;=153KPA
        DB      75T      ; x=145;=2.843v;=154KPA
        DB      74T      ; x=146;=2.863v;=155KPA
        DB      74T      ; x=147;=2.882v;=156KPA
        DB      73T      ; x=148;=2.902v;=157KPA
        DB      73T      ; x=149;=2.922v;=158KPA
        DB      72T      ; x=150;=2.941v;=159KPA
        DB      72T      ; x=151;=2.961v;=160KPA
        DB      71T      ; x=152;=2.980v;=161KPA
        DB      71T      ; x=153;=3.000v;=162KPA
        DB      70T      ; x=154;=3.020v;=163KPA
        DB      70T      ; x=155;=3.039v;=164KPA
        DB      69T      ; x=156;=3.059v;=165KPA
        DB      69T      ; x=157;=3.078v;=166KPA
        DB      69T      ; x=158;=3.098v;=167KPA
        DB      68T      ; x=159;=3.118v;=168KPA
        DB      68T      ; x=160;=3.137v;=169KPA
        DB      67T      ; x=161;=3.157v;=170KPA
        DB      67T      ; x=162;=3.176v;=171KPA
        DB      66T      ; x=163;=3.196v;=172KPA
        DB      66T      ; x=164;=3.216v;=173KPA
        DB      65T      ; x=165;=3.235v;=174KPA
        DB      65T      ; x=166;=3.255v;=175KPA
        DB      64T      ; x=167;=3.275v;=176KPA
        DB      64T      ; x=168;=3.294v;=176KPA
        DB      63T      ; x=169;=3.314v;=177KPA
        DB      63T      ; x=170;=3.333v;=178KPA
        DB      62T      ; x=171;=3.353v;=179KPA
        DB      62T      ; x=172;=3.373v;=180KPA
        DB      61T      ; x=173;=3.392v;=181KPA
        DB      61T      ; x=174;=3.412v;=182KPA
        DB      60T      ; x=175;=3.431v;=183KPA
        DB      60T      ; x=176;=3.451v;=184KPA
        DB      59T      ; x=177;=3.471v;=185KPA
        DB      59T      ; x=178;=3.490v;=186KPA
        DB      58T      ; x=179;=3.510v;=187KPA
        DB      58T      ; x=180;=3.529v;=188KPA
        DB      57T      ; x=181;=3.549v;=189KPa
        DB      57T      ; x=182;=3.569v;=190KPA
        DB      57T      ; x=183;=3.588v;=191KPA
        DB      56T      ; x=184;=3.608v;=192KPA
        DB      56T      ; x=185;=3.627v;=193KPA
        DB      55T      ; x=186;=3.647v;=194KPA
        DB      55T      ; x=187;=3.667v;=195KPA
        DB      54T      ; x=188;=3.686v;=196KPA
        DB      54T      ; x=189;=3.706v;=197KPA
        DB      53T      ; x=190;=3.725v;=198KPA
        DB      53T      ; x=191;=3.745v;=199KPA
        DB      52T      ; x=192;=3.765v;=199KPA
        DB      52T      ; x=193;=3.784v;=200KPA
        DB      51T      ; x=194;=3.804v;=201KPA
        DB      51T      ; x=195;=3.824v;=202KPA
        DB      50T      ; x=196;=3.843v;=203KPA
        DB      50T      ; x=197;=3.863v;=204KPA
        DB      49T      ; x=198;=3.882v;=205KPA
        DB      49T      ; x=199;=3.902v;=206KPA
        DB      48T      ; x=200;=3.922v;=207KPA
        DB      48T      ; x=201;=3.941v;=208KPA
        DB      47T      ; x=202;=3.961v;=209KPA
        DB      47T      ; x=203;=3.980v;=210KPA
        DB      46T      ; x=204;=4.000v;=211KPA
        DB      46T      ; x=205;=4.020v;=212KPA
        DB      45T      ; x=206;=4.039v;=213KPA
        DB      45T      ; x=207;=4.059v;=214KPA
        DB      45T      ; x=208;=4.078v;=215KPA
        DB      44T      ; x=209;=4.098v;=216KPA
        DB      44T      ; x=210;=4.118v;=217KPA
        DB      43T      ; x=211;=4.137v;=218KPA
        DB      43T      ; x=212;=4.157v;=219KPA
        DB      42T      ; x=213;=4.176v;=220KPA
        DB      42T      ; x=214;=4.196v;=221KPA
        DB      41T      ; x=215;=4.216v;=222KPA
        DB      41T      ; x=216;=4.235v;=222KPA
        DB      40T      ; x=217;=4.255v;=223KPA
        DB      40T      ; x=218;=4.275v;=224KPA
        DB      39T      ; x=219;=4.294v;=225KPA
        DB      39T      ; x=220;=4.314v;=226KPA
        DB      38T      ; x=221;=4.333v;=227KPA
        DB      38T      ; x=222;=4.353v;=228KPA
        DB      37T      ; x=223;=4.373v;=229KPA
        DB      37T      ; x=224;=4.392v;=230KPA
        DB      36T      ; x=225;=4.412v;=231KPA
        DB      36T      ; x=226;=4.431v;=232KPA
        DB      36T      ; x=227;=4.451v;=233KPA
        DB      35T      ; x=228;=4.471v;=234KPA
        DB      35T      ; x=229;=4.490v;=235KPA
        DB      34T      ; x=230;=4.510v;=236KPA
        DB      34T      ; x=231;=4.529v;=237KPA
        DB      34T      ; x=232;=4.549v;=238KPA
        DB      33T      ; x=233;=4.569v;=239KPA
        DB      33T      ; x=234;=4.588v;=240KPA
        DB      32T      ; x=235;=4.608v;=241KPA
        DB      32T      ; x=236;=4.627v;=242KPA
        DB      31T      ; x=237;=4.647v;=243KPA
        DB      31T      ; x=238;=4.667v;=244KPA
        DB      30T      ; x=239;=4.686v;=245KPA
        DB      30T      ; x=240;=4.706v;=246KPA
        DB      29T      ; x=241;=4.725v;=246KPA
        DB      29T      ; x=242;=4.745v;=247KPA
        DB      28T      ; x=243;=4.765v;=248KPA
        DB      28T      ; x=244;=4.784v;=249KPA
        DB      27T      ; x=245;=4.804v;=250KPA
        DB      27T      ; x=246;=4.824v;=251KPA
        DB      26T      ; x=247;=4.843v;=252KPA
        DB      26T      ; x=248;=4.863v;=253KPA
        DB      25T      ; x=249;=4.882v;=254KPA
        DB      25T      ; x=250;=4.902v;=255KPA
        DB      24T      ; x=251;=4.922v;=256KPA
        DB      24T      ; x=252;=4.941v;=257KPA
        DB      23T      ; x=253;=4.961v;=258KPA
        DB      23T      ; x=254;=4.980v;=259KPA
        DB      100T     ; x=255;=5.000v;=100KPA;=sensor fail
