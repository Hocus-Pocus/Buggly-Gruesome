; Generated manually by Robert Hiebert 10/03/22
; VW NTC12 # 1HM 906 501 IAT sensor
; VW NTC2 # ATV 906 161 2 Engine Temperature Sensor

; Computed Steinhart-Hart coefficients: 
; A = 0.0012516891022418901 
; B = .0002681094876698
; C = 1.2909966438108778e-7

; 14 deg F = 9300 Ohm
; 68 deg F = 2500 Ohm
; 176 deg F = 330 Ohm
; Use 2490 1% Bias resistor

; R1 = 2490
; R2 = (Vout*R1(/(5-Vout)

THERMFACTOR:									

;	Deg F+40    Deg F	Deg C	ADC	Vout	R2 (Ohms)		
 DB	220T	;	180		        0	Sensor failure use 180 deg F			
 DB	255T	;	502.6	261.4	1	0.020	10		
 DB	255T	;	414.8	212.7	2	0.039	20		
 DB	255T	;	370.3	188.0	3	0.059	30		
 DB	255T	;	341.3	171.8	4	0.078	40		
 DB	255T	;	320.1	160.0	5	0.098	50		
 DB	255T	;	303.6	150.9	6	0.118	60		
 DB	255T	;	290.1	143.4	7	0.137	70		
 DB	255T	;	277.8	136.5	8	0.157	81		
 DB	255T	;	268.2	131.2	9	0.176	91		
 DB	255T	;	259	    126.1	10	0.196	102		
 DB	255T	;	251.7	122.0	11	0.216	112		
 DB	255T	;	244.5	118.0	12	0.235	123		
 DB	255T	;	238	    114.4	13	0.255	134		
 DB	255T	;	232.1	111.2	14	0.275	145		
 DB	255T	;	226.8	108.2	15	0.294	156		
 DB	255T	;	221.8	105.5	16	0.314	167		
 DB	255T	;	217.3	102.9	17	0.333	178		
 DB	253T	;	213	    100.6	18	0.353	189		
 DB	249T	;	209.1	98.4	19	0.373	200		
 DB	245T	;	205.1	96.2	20	0.392	212		
 DB	242T	;	201.7	94.3	21	0.412	223		
 DB	238T	;	198.1	92.3	22	0.431	235		
 DB	235T	;	194.8	90.4	23	0.451	247		
 DB	232T	;	191.6	88.7	24	0.471	259		
 DB	229T	;	188.7	87.0	25	0.490	271		
 DB	226T	;	185.8	85.5	26	0.510	283		
 DB	223T	;	183.1	84.0	27	0.529	295		
 DB	221T	;	180.6	82.5	28	0.549	307		
 DB	218T	;	177.9	81.1	29	0.569	320		
 DB	216T	;	175.6	79.8	30	0.588	332		
 DB	213T	;	173.2	78.4	31	0.608	345		
 DB	211T	;	171	    77.2	32	0.627	357		
 DB	209T	;	168.9	76.0	33	0.647	370		
 DB	207T	;	166.7	74.8	34	0.667	383		
 DB	205T	;	164.7	73.7	35	0.686	396		
 DB	203T	;	162.7	72.6	36	0.706	409		
 DB	201T	;	160.8	71.5	37	0.725	423		
 DB	199T	;	158.9	70.5	38	0.745	436		
 DB	197T	;	157	    69.4	39	0.765	450		
 DB	195T	;	155.3	68.5	40	0.784	463		
 DB	194T	;	153.5	67.5	41	0.804	477		
 DB	192T	;	151.8	66.6	42	0.824	491		
 DB	190T	;	150.2	65.6	43	0.843	505		
 DB	189T	;	148.6	64.8	44	0.863	519		
 DB	187T	;	146.9	63.8	45	0.882	534		
 DB	185T	;	145.4	63.0	46	0.902	548		
 DB	184T	;	143.9	62.1	47	0.922	563		
 DB	182T	;	142.4	61.4	48	0.941	577		
 DB	181T	;	141	    60.5	49	0.961	592		
 DB	180T	;	139.6	59.8	50	0.980	607		
 DB	178T	;	138.1	58.9	51	1.000	623		
 DB	177T	;	136.7	58.2	52	1.020	638		
 DB	175T	;	135.4	57.5	53	1.039	653		
 DB	174T	;	134.1	56.7	54	1.059	669		 
 DB	173T	;	132.8	56.0	55	1.078	685	 	
 DB	172T	;	131.5	55.3	56	1.098	701		
 DB	170T	;	130.3	54.6	57	1.118	717		
 DB	169T	;	129	    53.9	58	1.137	733		
 DB	168T	;	127.8	53.2	59	1.157	750		
 DB	167T	;	126.6	52.6	60	1.176	766		
 DB	165T	;	125.4	51.9	61	1.196	783		
 DB	164T	;	124.3	51.3	62	1.216	800		
 DB	163T	;	123.1	50.6	63	1.235	817		
 DB	162T	;	122	    50.0	64	1.255	834		
 DB	161T	;	120.9	49.4	65	1.275	852		
 DB	160T	;	119.8	48.8	66	1.294	870		
 DB	159T	;	118.8	48.2	67	1.314	887		
 DB	158T	;	117.7	47.6	68	1.333	905		
 DB	157T	;	116.6	47.0	69	1.353	924		
 DB	156T	;	115.6	46.4	70	1.373	942		
 DB	155T	;	114.5	45.8	71	1.392	961		
 DB	154T	;	113.5	45.3	72	1.412	980		
 DB	153T	;	112.5	44.7	73	1.431	999		
 DB	152T	;	111.5	44.2	74	1.451	1018		
 DB	151T	;	110.5	43.6	75	1.471	1038		
 DB	150T	;	109.6	43.1	76	1.490	1057		
 DB	149T	;	108.6	42.6	77	1.510	1077		
 DB	148T	;	107.6	42.0	78	1.529	1097		
 DB	147T	;	106.7	41.5	79	1.549	1118		
 DB	146T	;	105.8	41.0	80	1.569	1138		
 DB	145T	;	104.8	40.5	81	1.588	1159		
 DB	144T	;	103.9	40.0	82	1.608	1180		
 DB	143T	;	103	    39.4	83	1.627	1202		
 DB	142T	;	102.1	39.0	84	1.647	1223		
 DB	141T	;	101.2	38.5	85	1.667	1245		
 DB	140T	;	100.3	38.0	86	1.686	1267		
 DB	140T	;	99.5	37.5	87	1.706	1289		
 DB	139T	;	98.6	37.0	88	1.725	1312		
 DB	138T	;	97.7	36.5	89	1.745	1335		
 DB	137T	;	96.9	36.0	90	1.765	1358		
 DB	136T	;	96	    35.6	91	1.784	1382		
 DB	135T	;	95.2	35.1	92	1.804	1405		
 DB	134T	;	94.4	34.6	93	1.824	1429		
 DB	134T	;	93.5	34.2	94	1.843	1454		
 DB	133T	;	92.7	33.7	95	1.863	1478		
 DB	132T	;	91.9	33.3	96	1.882	1503		
 DB	131T	;	91	    32.8	97	1.902	1529		
 DB	130T	;	90.3	32.4	98	1.922	1554		
 DB	130T	;	89.5	31.9	99	1.941	1580		
 DB	129T	;	88.7	31.5	100	1.961	1606		
 DB	128T	;	87.9	31.0	101	1.980	1633		
 DB	127T	;	87.1	30.6	102	2.000	1660		
 DB	126T	;	86.3	30.2	103	2.020	1687		
 DB	126T	;	85.5	29.7	104	2.039	1715		
 DB	125T	;	84.7	29.3	105	2.059	1743		
 DB	124T	;	84	    28.9	106	2.078	1771		
 DB	123T	;	83.2	28.4	107	2.098	1800		
 DB	122T	;	82.4	28.0	108	2.118	1829		
 DB	122T	;	81.7	27.6	109	2.137	1859		
 DB	121T	;	80.9	27.2	110	2.157	1889		
 DB	120T	;	80.2	26.8	111	2.176	1919		
 DB	119T	;	79.4	26.3	112	2.196	1950		
 DB	119T	;	78.7	25.9	113	2.216	1981		
 DB	118T	;	77.9	25.5	114	2.235	2013		
 DB	117T	;	77.2	25.1	115	2.255	2045		
 DB	117T	;	76.5	24.7	116	2.275	2078		
 DB	116T	;	75.7	24.3	117	2.294	2111		
 DB	115T	;	75	    23.9	118	2.314	2145		 
 DB	114T	;	74.3	23.5	119	2.333	2179	 	
 DB	114T	;	73.6	23.0	120	2.353	2213 		
 DB	113T	;	72.8	22.7	121	2.373	2248		
 DB	112T	;	72.1	22.3	122	2.392	2284		
 DB	111T	;	71.4	21.9	123	2.412	2320		
 DB	111T	;	70.7	21.5	124	2.431	2357		
 DB	110T	;	70	    21.0	125	2.451	2394		
 DB	109T	;	69.3	20.7	126	2.471	2432		
 DB	109T	;	68.5	20.3	127	2.490	2471		
 DB	108T	;	67.8	19.9	128	2.510	2510		
 DB	107T	;	67.2	19.5	129	2.529	2549		
 DB	106T	;	66.4	19.1	130	2.549	2590		
 DB	106T	;	65.7	18.7	131	2.569	2631		
 DB	105T	;	65	    18.3	132	2.588	2672		
 DB	104T	;	64.3	17.9	133	2.608	2715		
 DB	104T	;	63.6	17.6	134	2.627	2758		
 DB	103T	;	62.9	17.2	135	2.647	2801		
 DB	102T	;	62.2	16.8	136	2.667	2846		
 DB	102T	;	61.5	16.4	137	2.686	2891		
 DB	101T	;	60.8	16.0	138	2.706	2937		
 DB	100T	;	60.1	15.6	139	2.725	2984		
 DB	99T	    ;	59.4	15.2	140	2.745	3031		
 DB	99T	    ;	58.7	14.8	141	2.765	3080		
 DB	98T	    ;	58		14.4	142	2.784	3129		
 DB	97T	    ;	57.3	14.1	143	2.804	3179		
 DB	97T	    ;	56.7	13.7	144	2.824	3230		
 DB	96T	    ;	56		13.3	145	2.843	3282		
 DB	95T	    ;	55.3	12.9	146	2.863	3335		
 DB	95T	    ;	54.6	12.5	147	2.882	3389		
 DB	94T	    ;	53.9	12.2	148	2.902	3444		
 DB	93T	    ;	53.2	11.8	149	2.922	3500		
 DB	93T	    ;	52.5	11.4	150	2.941	3557		
 DB	92T	    ;	51.8	11.0	151	2.961	3615		
 DB	91T		;	51.1	10.6	152	2.980	3675		
 DB	90T		;	50.4	10.2	153	3.000	3735		
 DB	90T		;	49.7	9.8		154	3.020	3797		
 DB	89T		;	49		9.5		155	3.039	3860		
 DB	88T		;	48.3	9.1		156	3.059	3924		
 DB	88T		;	47.6	8.7		157	3.078	3989		
 DB	87T		;	46.9	8.3		158	3.098	4056		
 DB	86T		;	46.2	7.9		159	3.118	4124		
 DB	86T		;	45.5	7.5		160	3.137	4194		
 DB	85T		;	44.8	7.1		161	3.157	4265		
 DB	84T		;	44.1	6.7		162	3.176	4337		
 DB	83T		;	43.4	6.3		163	3.196	4412		
 DB	83T		;	42.7	5.9		164	3.216	4487		
 DB	82T		;	42		5.6		165	3.235	4565		
 DB	81T		;	41.3	5.2		166	3.255	4644		
 DB	81T		;	40.6	4.8		167	3.275	4725		
 DB	80T		;	39.9	4.4		168	3.294	4808		
 DB	79T		;	39.1	4.0		169	3.314	4893		
 DB	78T		;	38.4	3.6		170	3.333	4980		
 DB	78T		;	37.7	3.2		171	3.353	5069		
 DB	77T		;	37		2.8		172	3.373	5160		
 DB	76T		;	36.2	2.4		173	3.392	5253		
 DB	76T		;	35.5	2.0		174	3.412	5349		
 DB	75T		;	34.8	1.5		175	3.431	5447		
 DB	74T		;	34.1	1.1		176	3.451	5547		
 DB	73T		;	33.3	1.0		177	3.471	5650		
 DB	73T		;	32.6	0.3		178	3.490	5756		
 DB	72T		;	31.8	-0.1	179	3.510	5865		
 DB	71T		;	31.1	-0.5	180	3.529	5976		
 DB	70T		;	30.3	-0.9	181	3.549	6090		
 DB	70T		;	29.6	-1.4	182	3.569	6208		
 DB	69T		;	28.8	-1.8	183	3.588	6329		
 DB	68T		;	28		-2.2	184	3.608	6453		
 DB	67T		;	27.3	-2.6	185	3.627	6581		
 DB	67T		;	26.5	-3.1	186	3.647	6712		
 DB	66T		;	25.7	-3.5	187	3.667	6848		
 DB	65T		;	24.9	-3.9	188	3.686	6987		
 DB	64T		;	24.1	-4.4	189	3.706	7130		
 DB	63T		;	23.3	-4.8	190	3.725	7278		
 DB	63T		;	22.5	-5.3	191	3.745	7431		
 DB	62T		;	21.7	-5.7	192	3.765	7589		
 DB	61T		;	20.9	-6.2	193	3.784	7751		
 DB	60T		;	20.1	-6.6	194	3.804	7919		
 DB	59T		;	19.3	-7.1	195	3.824	8093		
 DB	58T		;	18.4	-7.5	196	3.843	8272		
 DB	58T		;	17.6	-8.0	197	3.863	8457		
 DB	57T		;	16.7	-8.5	198	3.882	8649		
 DB	56T		;	15.9	-9.0	199	3.902	8848		
 DB	55T		;	15		-9.4	200	3.922	9055		
 DB	54T		;	14.1	-9.9	201	3.941	9268		
 DB	53T		;	13.2	-10.4	202	3.961	9490		
 DB	52T		;	12.3	-10.9	203	3.980	9721		
 DB	51T		;	11.4	-11.4	204	4.000	9960		
 DB	51T		;	10.5	-11.9	205	4.020	10209		
 DB	50T		;	9.6		-12.4	206	4.039	10468		
 DB	49T		;	8.7		-13.0	207	4.059	10738		
 DB	48T		;	7.7		-13.5	208	4.078	11020		
 DB	47T		;	6.8		-14.0	209	4.098	11313		
 DB	46T		;	5.8		-14.6	210	4.118	11620		
 DB	45T		;	4.8		-15.1	211	4.137	11941		
 DB	44T		;	3.8		-15.7	212	4.157	12276		
 DB	43T		;	2.8		-16.2	213	4.176	12628		
 DB	42T		;	1.7		-16.8	214	4.196	12997		
 DB	41T		;	0.7		-17.4	215	4.216	13384		
 DB	40T		;	-0.4	-18.0	216	4.235	13791		
 DB	39T		;	-1.5	-18.6	217	4.255	14219		
 DB	37T		;	-2.6	-19.2	218	4.275	14671		
 DB	36T		;	-3.7	-19.8	219	4.294	15148		
 DB	35T		;	-4.8	-20.5	220	4.314	15651		
 DB	34T		;	-6		-21.1	221	4.333	16185		
 DB	33T		;	-7.2	-21.8	222	4.353	16751		
 DB	32T		;	-8.4	-22.5	223	4.373	17352		
 DB	30T		;	-9.7	-23.1	224	4.392	17992		
 DB	29T		;	-10.9	-23.9	225	4.412	18675		
 DB	28T		;	-12.2	-24.6	226	4.431	19405		
 DB	26T		;	-13.6	-25.3	227	4.451	20187		
 DB	25T		;	-15		-26.1	228	4.471	21027		
 DB	24T		;	-16.4	-26.9	229	4.490	21931		
 DB	22T		;	-17.8	-27.7	230	4.510	22908		
 DB	21T		;	-19.3	-28.5	231	4.529	23966		
 DB	19T		;	-20.9	-29.4	232	4.549	25117		
 DB	18T		;	-22.5	-30.3	233	4.569	26371		
 DB	16T		;	-24.1	-31.2	234	4.588	27746		
 DB	14T		;	-25.9	-32.1	235	4.608	29258		
 DB	12T		;	-27.7	-33.1	236	4.627	30928		
 DB	11T		;	-29.5	-34.2	237	4.647	32785		
 DB	9T		;	-31.5	-35.3	238	4.667	34860		
 DB	7T		;	-33.5	-36.4	239	4.686	37194		
 DB	4T		;	-35.6	-37.6	240	4.706	39840		
 DB	2T		;	-37.9	-38.8	241	4.725	42864		
 DB	0T		;	-40.3	-40.2	242	4.745	46352		
 DB	0T		;	-42.9	-41.6	243	4.765	50423		
 DB	0T		;	-45.6	-43.1	244	4.784	55233		
 DB	0T		;	-48.6	-44.8	245	4.804	61005		
 DB	0T		;	-51.8	-46.6	246	4.824	68060		
 DB	0T		;	-55.3	-48.1	247	4.843	76879		
 DB	0T		;	-59.3	-50.7	248	4.863	88217		
 DB	0T		;	-63.7	-53.2	249	4.882	103335		
 DB	0T		;	-68.8	-56.0	250	4.902	124500		
 DB	0T		;	-75		-59.4	251	4.922	156247		
 DB	0T		;	-82.6	-63.7	252	4.941	209160		
 DB	0T		;	-92.9	-69.4	253	4.961	314985		
 DB	0T		;	-109.5	-78.6	254	4.980	632460		
 DB	220T	;	 180			255	Sensor failure , use 180 deg F			

